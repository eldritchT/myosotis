## Config.in
```kconfig
menu "myosotis config"

config BR2_MYOSOTIS_DEBUG
    bool "enable debug extras"

config BR2_MYOSOTIS_SESSION_USER
	string "Graphical session user (must match users.txt)"
	default "myosotis"

endmenu
```

## configs/myosotis_qemu_x86_64_defconfig
```kconfig
BR2_x86_64=y
BR2_PACKAGE_HOST_LINUX_HEADERS_CUSTOM_6_18=y
BR2_TOOLCHAIN_BUILDROOT_GLIBC=y
BR2_TOOLCHAIN_BUILDROOT_CXX=y
BR2_ENABLE_LOCALE=y
BR2_GENERATE_LOCALE="en_US.UTF-8"
BR2_CCACHE=y
BR2_JLEVEL=6

BR2_INIT_SYSTEMD=y
BR2_ROOTFS_DEVICE_CREATION_DYNAMIC_EUDEV=y
BR2_ROOTFS_SKELETON_DEFAULT=y
BR2_TARGET_GENERIC_HOSTNAME="qemu"
BR2_TARGET_GENERIC_ISSUE="myosotis"
# BR2_TARGET_GENERIC_GETTY is not set
BR2_TARGET_GENERIC_REMOUNT_ROOTFS_RW=y

BR2_ROOTFS_OVERLAY="$(BR2_EXTERNAL_MYOSOTIS_PATH)/board/myosotis/common/rootfs-overlay"
BR2_ROOTFS_POST_BUILD_SCRIPT="$(BR2_EXTERNAL_MYOSOTIS_PATH)/board/myosotis/common/post-build.sh"
BR2_ROOTFS_POST_IMAGE_SCRIPT="$(BR2_EXTERNAL_MYOSOTIS_PATH)/board/myosotis/common/post-image.sh"
BR2_ROOTFS_USERS_TABLES="$(BR2_EXTERNAL_MYOSOTIS_PATH)/board/myosotis/common/users.txt"

BR2_LINUX_KERNEL=y
BR2_LINUX_KERNEL_CUSTOM_VERSION=y
BR2_LINUX_KERNEL_CUSTOM_VERSION_VALUE="6.18.7"
BR2_LINUX_KERNEL_USE_CUSTOM_CONFIG=y
BR2_LINUX_KERNEL_CUSTOM_CONFIG_FILE="$(BR2_EXTERNAL_MYOSOTIS_PATH)/board/myosotis/qemu_x86_64/linux.config"
BR2_LINUX_KERNEL_NEEDS_HOST_LIBELF=y

BR2_TARGET_ROOTFS_EXT2=y
BR2_TARGET_ROOTFS_EXT2_4=y
BR2_TARGET_ROOTFS_EXT2_SIZE="512M"
BR2_TARGET_ROOTFS_EXT2_LABEL="myosotis-root"
# BR2_TARGET_ROOTFS_TAR is not set

BR2_PACKAGE_SYSTEMD=y
BR2_PACKAGE_SKELETON_INIT_SYSTEMD=y
BR2_PACKAGE_SYSTEMD_NETWORKD=y
BR2_PACKAGE_SYSTEMD_LOGIND=y
BR2_PACKAGE_SYSTEMD_TIMEDATE=y
BR2_PACKAGE_SYSTEMD_JOURNALD=y
BR2_PACKAGE_SYSTEMD_HOSTNAMED=y

BR2_PACKAGE_EUDEV=y
# BR2_PACKAGE_EUDEV_MODULE_LOADING is not set

BR2_PACKAGE_ALSA_LIB=y
BR2_PACKAGE_ALSA_UTILS=y
BR2_PACKAGE_ALSA_UTILS_ALSACTL=y
BR2_PACKAGE_ALSA_UTILS_ALSAMIXER=y
BR2_PACKAGE_ALSA_UTILS_AMIXER=y
BR2_PACKAGE_ALSA_UTILS_APLAY=y
BR2_PACKAGE_ALSA_UTILS_SPEAKER_TEST=y
BR2_PACKAGE_PIPEWIRE=y
BR2_PACKAGE_LIBSNDFILE=y
BR2_PACKAGE_WIREPLUMBER=y
BR2_PACKAGE_LUA=y
BR2_PACKAGE_LUA_5_4=y
BR2_PACKAGE_DBUS=y
BR2_PACKAGE_DBUS_BROKER=y

BR2_PACKAGE_MESA3D=y
BR2_PACKAGE_MESA3D_GALLIUM_DRIVER_SOFTPIPE=y
BR2_PACKAGE_MESA3D_GALLIUM_DRIVER_VIRGL=y
BR2_PACKAGE_MESA3D_OPENGL_EGL=y
BR2_PACKAGE_MESA3D_OPENGL_ES=y
BR2_PACKAGE_SEATD=y
BR2_PACKAGE_SEATD_DAEMON=y
BR2_PACKAGE_SWAY=y
BR2_PACKAGE_SWAY_SWAYBAR=y
BR2_PACKAGE_SWAY_SWAYNAG=y
BR2_PACKAGE_SWAYBG=y
BR2_PACKAGE_WAYLAND_UTILS=y

BR2_PACKAGE_FOOT=y
BR2_PACKAGE_FOOT_THEMES=y
BR2_PACKAGE_DEJAVU=y
BR2_PACKAGE_DEJAVU_MONO=y
BR2_PACKAGE_DEJAVU_SANS=y

BR2_PACKAGE_ZSH=y
BR2_PACKAGE_SUDO=y
# BR2_SYSTEM_BIN_SH="/usr/bin/zsh"
BR2_PACKAGE_BUSYBOX_SHOW_OTHERS=y
BR2_USE_MMU=y
```

## configs/myosotis_r36s_clone_defconfig
```kconfig
BR2_aarch64=y
BR2_cortex_a35=y

BR2_PACKAGE_HOST_LINUX_HEADERS_CUSTOM_6_18=y
BR2_TOOLCHAIN_BUILDROOT_GLIBC=y
BR2_TOOLCHAIN_BUILDROOT_CXX=y
BR2_ENABLE_LOCALE=y
BR2_GENERATE_LOCALE="en_US.UTF-8"
BR2_CCACHE=y
BR2_JLEVEL=6

BR2_INIT_SYSTEMD=y
BR2_ROOTFS_SKELETON_DEFAULT=y
BR2_TARGET_GENERIC_HOSTNAME="r36s"
BR2_TARGET_GENERIC_ISSUE="myosotis"
# BR2_TARGET_GENERIC_GETTY is not set
BR2_TARGET_GENERIC_REMOUNT_ROOTFS_RW=y
# BR2_SYSTEM_DHCP is not set

BR2_ROOTFS_OVERLAY="$(BR2_EXTERNAL_MYOSOTIS_PATH)/board/myosotis/common/rootfs-overlay \
	$(BR2_EXTERNAL_MYOSOTIS_PATH)/board/myosotis/r36s/rootfs-overlay"
BR2_ROOTFS_POST_BUILD_SCRIPT="$(BR2_EXTERNAL_MYOSOTIS_PATH)/board/myosotis/r36s/post-build.sh"
BR2_ROOTFS_POST_IMAGE_SCRIPT="support/scripts/genimage.sh"
BR2_ROOTFS_POST_IMAGE_SCRIPT_ARGS="-c $(BINARIES_DIR)/genimage.cfg"
BR2_ROOTFS_USERS_TABLES="$(BR2_EXTERNAL_MYOSOTIS_PATH)/board/myosotis/common/users.txt"

BR2_LINUX_KERNEL=y
BR2_LINUX_KERNEL_CUSTOM_VERSION=y
BR2_LINUX_KERNEL_CUSTOM_VERSION_VALUE="6.18.7"
BR2_LINUX_KERNEL_USE_ARCH_DEFAULT_CONFIG=y
BR2_LINUX_KERNEL_CONFIG_FRAGMENT_FILES="$(BR2_EXTERNAL_MYOSOTIS_PATH)/board/myosotis/r36s/linux.fragment"
BR2_LINUX_KERNEL_DTS_SUPPORT=y
BR2_LINUX_KERNEL_CUSTOM_DTS_DIR="$(BR2_EXTERNAL_MYOSOTIS_PATH)/board/myosotis/r36s/dts"
BR2_LINUX_KERNEL_INTREE_DTS_NAME="rockchip/rk3326-r36s"
BR2_LINUX_KERNEL_DTB_KEEP_DIRNAME=y
BR2_LINUX_KERNEL_INSTALL_TARGET=y

BR2_TARGET_ROOTFS_EXT2=y
BR2_TARGET_ROOTFS_EXT2_4=y
BR2_TARGET_ROOTFS_EXT2_SIZE="1024M"
BR2_TARGET_ROOTFS_EXT2_LABEL="myosotis-root"
# BR2_TARGET_ROOTFS_TAR is not set

BR2_TARGET_UBOOT=y
BR2_TARGET_UBOOT_BUILD_SYSTEM_KCONFIG=y
BR2_TARGET_UBOOT_CUSTOM_VERSION=y
BR2_TARGET_UBOOT_CUSTOM_VERSION_VALUE="2026.01"
BR2_TARGET_UBOOT_BOARD_DEFCONFIG="odroid-go2"
BR2_TARGET_UBOOT_NEEDS_DTC=y
BR2_TARGET_UBOOT_NEEDS_PYLIBFDT=y
BR2_TARGET_UBOOT_NEEDS_PYELFTOOLS=y
BR2_TARGET_UBOOT_NEEDS_OPENSSL=y
BR2_TARGET_UBOOT_USE_BINMAN=y
BR2_TARGET_UBOOT_NEEDS_ROCKCHIP_RKBIN=y

BR2_PACKAGE_ROCKCHIP_RKBIN=y
BR2_PACKAGE_ROCKCHIP_RKBIN_TPL_FILENAME="bin/rk33/rk3326_ddr_333MHz_v2.12.bin"
BR2_PACKAGE_ROCKCHIP_RKBIN_BL31_FILENAME="bin/rk33/rk3326_bl31_v1.37.elf"

BR2_PACKAGE_HOST_GENIMAGE=y

BR2_PACKAGE_MESA3D=y
BR2_PACKAGE_MESA3D_LLVM=y
BR2_PACKAGE_MESA3D_GALLIUM_DRIVER_PANFROST=y
BR2_PACKAGE_MESA3D_GBM=y
BR2_PACKAGE_MESA3D_OPENGL_EGL=y
BR2_PACKAGE_MESA3D_OPENGL_ES=y
BR2_PACKAGE_LIBDRM=y
BR2_PACKAGE_WAYLAND=y
BR2_PACKAGE_WAYLAND_PROTOCOLS=y
BR2_PACKAGE_WAYLAND_UTILS=y
BR2_PACKAGE_WLROOTS=y
BR2_PACKAGE_SWAY=y
BR2_PACKAGE_SWAY_SWAYBAR=y
BR2_PACKAGE_SWAYBG=y
BR2_PACKAGE_LIBINPUT=y
BR2_PACKAGE_SEATD=y
BR2_PACKAGE_SEATD_DAEMON=y
BR2_PACKAGE_DBUS=y
BR2_PACKAGE_DBUS_BROKER=y
BR2_PACKAGE_PIPEWIRE=y
BR2_PACKAGE_WIREPLUMBER=y
BR2_PACKAGE_FOOT=y
BR2_PACKAGE_FONTCONFIG=y
```
